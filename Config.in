## Config.in
```kconfig
source "$BR2_EXTERNAL_DIRECTFB2_PATH/package/directfb2/Config.in"
source "$BR2_EXTERNAL_DIRECTFB2_PATH/package/directfb2-examples/Config.in"
source "$BR2_EXTERNAL_DIRECTFB2_PATH/package/directfb2-media/Config.in"
source "$BR2_EXTERNAL_DIRECTFB2_PATH/package/directfb2-tools/Config.in"
source "$BR2_EXTERNAL_DIRECTFB2_PATH/package/directfb2-csource/Config.in"
source "$BR2_EXTERNAL_DIRECTFB2_PATH/package/dfbterm/Config.in"
source "$BR2_EXTERNAL_DIRECTFB2_PATH/package/flux/Config.in"
source "$BR2_EXTERNAL_DIRECTFB2_PATH/package/dfb2lite/Config.in"
source "$BR2_EXTERNAL_DIRECTFB2_PATH/package/portablegl/Config.in"
#hacks
source "$BR2_EXTERNAL_DIRECTFB2_PATH/package/sdl/Config.in"
source "$BR2_EXTERNAL_DIRECTFB2_PATH/package/sdl2/Config.in"
```

## package/dfb2lite/Config.in
```kconfig
config BR2_PACKAGE_DFB2LITE
	bool "DirectFB2 LiTE"
	depends on BR2_PACKAGE_DIRECTFB2
	help
	  lite toolkit for dfb2
```

## package/dfbterm/Config.in
```kconfig
config BR2_PACKAGE_DFBTERM
	bool "dfbterm"
	depends on BR2_PACKAGE_DFB2LITE
	help
	  Terminal emulator for DirectFB2
```

## package/directfb2-csource/Config.in
```kconfig
config BR2_PACKAGE_DIRECTFB2_CSOURCE
	bool "directfb2-csource"
	depends on BR2_PACKAGE_DIRECTFB2
	help
	  DirectFB2 csource.
```

## package/directfb2-examples/Config.in
```kconfig
config BR2_PACKAGE_DIRECTFB2_EXAMPLES
	bool "directfb2-examples"
	depends on BR2_PACKAGE_DIRECTFB2
	help
	  DirectFB2 example programs.
```

## package/directfb2-media/Config.in
```kconfig
config BR2_PACKAGE_DIRECTFB2_MEDIA
	bool "directfb2-media"
	depends on BR2_PACKAGE_DIRECTFB2
	depends on BR2_PACKAGE_HAS_JPEG
	help
	  DirectFB2 media programs.
```

## package/directfb2-tools/Config.in
```kconfig
config BR2_PACKAGE_DIRECTFB2_TOOLS
	bool "directfb2-tools"
	depends on BR2_PACKAGE_DIRECTFB2
	help
	  DirectFB2 tools.
```

## package/directfb2/Config.in
```kconfig
config BR2_PACKAGE_DIRECTFB2
	bool "directfb2"
	depends on !BR2_PACKAGE_DIRECTFB
	select BR2_PACKAGE_FLUX
	help
	  DirectFB2 is a fork of DirectFB.

config BR2_PACKAGE_DIRECTFB2_MULTI
	bool "enable multiple application support"
	depends on BR2_PACKAGE_DIRECTFB2

config BR2_PACKAGE_DIRECTFB2_DRMKMS
	bool "DRM/KMS backend"
	depends on BR2_PACKAGE_DIRECTFB2
	select BR2_PACKAGE_LIBDRM

config BR2_PACKAGE_DIRECTFB2_FBDEV
	bool "fbdev backend"
	depends on BR2_PACKAGE_DIRECTFB2
```

## package/sdl/Config.in
```kconfig
if BR2_PACKAGE_SDL

config BR2_PACKAGE_SDL_DIRECTFB2
        bool "SDL DirectFB2 video driver"
        depends on BR2_PACKAGE_DIRECTFB2

endif
```

## package/sdl2/Config.in
```kconfig
if BR2_PACKAGE_SDL2

config BR2_PACKAGE_SDL2_DIRECTFB2
        bool "SDL2: DirectFB2 video driver"
        depends on BR2_PACKAGE_DIRECTFB2

comment "SDL2: DirectFB2 video driver needs directfb2"
        depends on !BR2_PACKAGE_DIRECTFB2

endif
```
